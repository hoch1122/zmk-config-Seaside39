## config/boards/shields/Seaside39/Kconfig.shield
```kconfig
config SHIELD_Seaside39_R
    def_bool $(shields_list_contains,Seaside39_R)

config SHIELD_Seaside39_L
    def_bool $(shields_list_contains,Seaside39_L)

config PMW3610_DEADZONE_THRESHOLD
    int "Deadzone threshold for movement filtering"
    default 4
    help
      Ignore movement if x^2 + y^2 is smaller than this value.
```
